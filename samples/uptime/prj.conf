## CMakeLists.txt
```
#
# Copyright 2023, Victor Chavez
#
# SPDX-License-Identifier: Apache-2.0
#
cmake_minimum_required(VERSION 3.20.0)

set(ZEPHYR_EXTRA_MODULES ${CMAKE_CURRENT_SOURCE_DIR}/../..)

find_package(Zephyr REQUIRED HINTS $ENV{ZEPHYR_BASE})
project(peripheral_hr)


target_sources(app PRIVATE
  src/main.cpp
  src/ble.cpp
  src/uptime_service.cpp
)

target_compile_options(app PUBLIC)
```

## prj.conf
```kconfig
#
# Copyright 2024, Victor Chavez
#
# SPDX-License-Identifier: Apache-2.0
#
CONFIG_CPP=y
CONFIG_STD_CPP17=y
CONFIG_BT=y
CONFIG_BT_PERIPHERAL=y
CONFIG_BT_DEVICE_NAME="BLEUtils_Uptime"
CONFIG_BLE_UTILS=y
CONFIG_BT_ASSERT=n
CONFIG_LOG=y
CONFIG_BT_EXT_ADV=y
CONFIG_BT_CTLR_ADV_DATA_LEN_MAX=100
```

## src/main.cpp
```c
/*!*****************************************************************
* Copyright 2023-2024, Victor Chavez
* SPDX-License-Identifier: Apache-2.0
* @file main.cpp
* @author Victor Chavez (vchavezb@protonmail.com)
*
* @brief
* Main source file that implements an uptime service demo for the BLE utils module
*
* @par Dependencies
* - language: C++17
* - OS: Zephyr v3.2.x
********************************************************************/

#include "ble.hpp"
#include <zephyr/kernel.h>
#include <zephyr/logging/log.h>
#include "uptime_service.hpp"
LOG_MODULE_REGISTER(main, CONFIG_LOG_DEFAULT_LEVEL);

uptime::Service uptime_service;

int main(void)
{
	LOG_INF("Starting Uptime BLE Utils sample");
	uptime_service.init();
	ble::register_svc_to_scan_rsp(uptime_service.get_uuid());
	ble::init();
	for (;;) {
		const uint32_t uptime_ms = k_uptime_get_32();
		uptime_service.update(uptime_ms/1000U);
		k_sleep(K_MSEC(1000));		
	}
	return 0;
}
```

## src/ble.cpp
```c
/*!*****************************************************************
* Copyright 2023-2024, Victor Chavez
* SPDX-License-Identifier: Apache-2.0
* @file main.cpp
* @author Victor Chavez (vchavezb@protonmail.com)
*
* @brief
* BLE connection implementation for uptime service demo
*
* @par Dependencies
* - language: C++17
* - OS: Zephyr v3.2.x
********************************************************************/
#include <zephyr/bluetooth/conn.h>
#include <zephyr/logging/log.h>
#include "ble.hpp"
LOG_MODULE_REGISTER(ble, CONFIG_LOG_DEFAULT_LEVEL);

namespace ble
{

constexpr size_t MAX_SD_SIZE {5U};
static size_t sd_cnt = 0;

static struct bt_data sd_data[MAX_SD_SIZE] = {};
static constexpr bt_le_adv_param adv_param = BT_LE_ADV_PARAM_INIT(BT_LE_ADV_OPT_CONNECTABLE |
																		BT_LE_ADV_OPT_USE_NAME,
																	BT_GAP_ADV_FAST_INT_MIN_2,
																	BT_GAP_ADV_FAST_INT_MAX_2,
																	NULL);

static constexpr bt_data adv_data[] =
{
	BT_DATA_BYTES(BT_DATA_FLAGS, (BT_LE_AD_GENERAL | BT_LE_AD_NO_BREDR))
};

static void connected(bt_conn *conn, uint8_t conn_err)
{
	int err;
	bt_conn_info info;
	char addr[BT_ADDR_LE_STR_LEN];

	bt_addr_le_to_str(bt_conn_get_dst(conn), addr, sizeof(addr));

	if (conn_err)
    {
		LOG_INF("Connection failed (err %d)", conn_err);
		return;
	}

	err = bt_conn_get_info(conn, &info);
	if (err)
    {
		LOG_ERR("Failed to get connection info (err %d)", err);
	}
    else 
    {
		LOG_INF("Connected: %s\n", addr);
	}
}

static void disconnected(struct bt_conn *conn, uint8_t reason)
{
	LOG_INF("Disconnected (reason 0x%02x)", reason);
}

BT_CONN_CB_DEFINE(conn_callbacks) =
{
	.connected = connected,
	.disconnected = disconnected,
};

static int start_adv(void)
{
 	int err = bt_le_adv_start(&adv_param,
                                adv_data,
                                ARRAY_SIZE(adv_data),
                                sd_data,
                                sd_cnt);

	if (err) {
		LOG_ERR("Failed to create advertiser set (err %d)", err);
		return err;
	}
	return 0;
}

bool register_svc_to_scan_rsp(const bt_uuid *uuid)
{
	uint8_t data_len;
	const uint8_t * p_data;
	uint8_t adv_type;
	switch(uuid->type){
		case BT_UUID_TYPE_16:
			data_len = 2;
			adv_type = BT_DATA_UUID16_SOME;
			p_data = (const uint8_t *)&((bt_uuid_16 *)uuid)->val;
			break;
		case BT_UUID_TYPE_32:
			data_len = 4;
			adv_type = BT_DATA_UUID32_SOME;
			p_data = (const uint8_t *)&((bt_uuid_32 *)uuid)->val;
			break;
		case BT_UUID_TYPE_128:
			data_len = 16;
			adv_type = BT_DATA_UUID128_SOME;
			p_data = (const uint8_t *)&((bt_uuid_128 *)uuid)->val[0];
			break;
		default:
			return false;
	}

	if (sd_cnt < MAX_SD_SIZE) {
		bt_data data = {.
			type = adv_type,
			.data_len = data_len,
			.data = p_data
		};
		sd_data[sd_cnt++] = data;
		return true;
	}
	return false;
}

int init()
{
  	int err;
	do
	{
		err = bt_enable(NULL);
		if (err)
		{
			LOG_ERR("Bluetooth init failed (err %d)", err);
			break;
		}

		LOG_INF("Bluetooth initialized\n");
		err = start_adv();
		if (err)
		{
			LOG_ERR("Advertising failed to create (err %d)", err);
			break;
		}
	}while(0);
	return err;  
}
} // namespace ble
```

## src/ble.hpp
```c
/*!*****************************************************************
* Copyright 2023, Victor Chavez
* SPDX-License-Identifier: Apache-2.0
* @file main.cpp
* @author Victor Chavez (vchavezb@protonmail.com)
*
* @brief
* BLE connection functions for uptime service demo
*
* @par Dependencies
* - language: C++17
* - OS: Zephyr v3.2.x
********************************************************************/
#include <zephyr/bluetooth/uuid.h>

namespace ble
{
/**
 * @brief Initialize BLE connection
 * 
 * @return zephyr bluetooth error value
 */
int init();

/**
 * @brief Registers a service to the scan response message
 * when advertising.
 *
 * @param uuid The 128 bit uuid of the service.
 * @return true on success.
 * @return false when the maximum number of configurable services is reached.
 */
bool register_svc_to_scan_rsp(const bt_uuid *uuid);

} // namespace ble
```

## src/uptime_service.cpp
```c
/*!*****************************************************************
* Copyright 2023-2024, Victor Chavez
* SPDX-License-Identifier: Apache-2.0
* @file main.cpp
* @author Victor Chavez (vchavezb@protonmail.com)
*
* @brief
* BLE Service implementation
*
* @par Dependencies
* - language: C++17
* - OS: Zephyr v3.2.x
********************************************************************/
#include <zephyr/logging/log.h>
#include "uptime_service.hpp"

LOG_MODULE_REGISTER(uptime_svc, CONFIG_LOG_DEFAULT_LEVEL);

namespace uptime
{

namespace characteristic
{

Basic::Basic():
    ble_utils::gatt::Characteristic((const bt_uuid*)&uuid::char_basic,
                                    BT_GATT_CHRC_READ,
                                    BT_GATT_PERM_READ)
{
}

ssize_t Basic::read_cb(void *buf, uint16_t len, uint16_t offset)
{
    ARG_UNUSED(offset);
    uint8_t * pUptime = static_cast<uint8_t*>(buf);
    pUptime[0] = m_uptime & 0xFF;
    pUptime[1] = m_uptime>>8 & 0xFF;
    pUptime[2] = m_uptime>>16 & 0xFF;
    pUptime[3] = m_uptime>>24 & 0xFF;
    return sizeof(m_uptime);
}

void Basic::update(uint32_t uptime)
{
    m_uptime = uptime;
}

Notify::Notify():
    ble_utils::gatt::CharacteristicNotify((const bt_uuid*)&uuid::char_notify)    
{
}

void Notify::ccc_changed(CCCValue_e value)
{
    int val = static_cast<int>(value);
    LOG_INF("Characteristic Notify Uptime CCC changed %d\n",val);
}

Indicate::Indicate():
    ble_utils::gatt::CharacteristicIndicate((const bt_uuid*)&uuid::char_indicate)    
{
}

void Indicate::ccc_changed(CCCValue_e value)
{
    int val = static_cast<int>(value);
    LOG_INF("Characteristic Indicate Uptime CCC changed %d\n",val);
}
void Indicate::indicate_rsp()
{
    LOG_INF("Characteristic Indicate Uptime Completed\n");
}

} // namespace characteristic

Service::Service():
    ble_utils::gatt::Service((const bt_uuid*)&uuid::svc_base)
{
    register_char(&m_basic);
    register_char(&m_indicate);
    register_char(&m_notify);
}

void Service::update(uint32_t uptime)
{
    m_basic.update(uptime);
    m_notify.notify(&uptime,sizeof(uptime));
    m_indicate.indicate(&uptime,sizeof(uptime));
}

} // namespace uptime
```

## src/uptime_service.hpp
```c
/*!*****************************************************************
* Copyright 2023-2024, Victor Chavez
* SPDX-License-Identifier: Apache-2.0
* @file main.cpp
* @author Victor Chavez (vchavezb@protonmail.com)
*
* @brief
* Uptime BLE Service that uses the BLE Utils module
*
* @par Dependencies
* - language: C++17
* - OS: Zephyr v3.2.x
********************************************************************/

#pragma once
#include <ble_utils/ble_utils.hpp>
#include <ble_utils/uuid.hpp>


namespace uptime
{

namespace uuid
{
    static constexpr bt_uuid_128 svc_base = ble_utils::uuid::uuid128_init(0xABCD0000,
                                                                        0x1234,
                                                                        0x5678,
                                                                        0x9ABC,
                                                                        0xDEF012345678);

    static constexpr bt_uuid_128 char_basic = ble_utils::uuid::derive_uuid(svc_base,0x0001);
    static constexpr bt_uuid_128 char_notify = ble_utils::uuid::derive_uuid(svc_base,0x0002);
    static constexpr bt_uuid_128 char_indicate = ble_utils::uuid::derive_uuid(svc_base,0x0003);
}

namespace characteristic
{

class Basic final: public ble_utils::gatt::Characteristic
{
public:
    Basic();
    void update(uint32_t uptime);
private:
    ssize_t read_cb(void *buf, uint16_t len, uint16_t offset) override;
    uint32_t m_uptime{0};
};

class Notify final: public ble_utils::gatt::CharacteristicNotify
{
public:
    Notify();
private:
    void ccc_changed(CCCValue_e value) override;
};

class Indicate final: public ble_utils::gatt::CharacteristicIndicate
{
public:
    Indicate();
private:
    void ccc_changed(CCCValue_e value) override;
    void indicate_rsp();
};

}

class Service: public ble_utils::gatt::Service
{
    public:
        Service();
        void update(uint32_t uptime);
    private:
        characteristic::Basic m_basic;
        characteristic::Indicate m_indicate;
        characteristic::Notify m_notify;   
};

} // namespace uptime
```
