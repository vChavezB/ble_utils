## samples/boards/native_posix_64.conf
```kconfig
# Disable HCI ACL for use with Android Emulator
# Refer to https://github.com/google/bumble/issues/220#issuecomment-1651200456
CONFIG_BT_HCI_ACL_FLOW_CONTROL=n
```

## zephyr/KConfig
```kconfig
# Copyright 2023, Victor Chavez
# SPDX-License-Identifier: Apache-2.0

config BLE_UTILS
    bool "BLE Utils"
    select BT_GATT_DYNAMIC_DB
    default n
    help
        Enables the BLE Utils Module
        
if BLE_UTILS

config BLE_UTILS_MAX_ATTR
	int "Maximum attributes entry for Service"
	range 1 30
	default 10
	help
	  Number of attributes a service holds internally.
	  At least one is required for the service. Each BLE Char
	  requires between two or three attributes (Notify,indicate respectively).
      

module = BLEUTILS
module-str = ble-utils

endif
```
